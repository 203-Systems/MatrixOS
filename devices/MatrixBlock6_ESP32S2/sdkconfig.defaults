## devices/MatrixBlock6_ESP32S3/sdkconfig.defaults
```kconfig
CONFIG_FREERTOS_HZ=240
 
CONFIG_ESP_TASK_WDT_CHECK_IDLE_TASK_CPU0=n
CONFIG_ESP_TASK_WDT_CHECK_IDLE_TASK_CPU1=n

CONFIG_FREERTOS_TIMER_TASK_STACK_DEPTH=4096

CONFIG_EFUSE_CODE_SCHEME_COMPAT_NONE=y
```

## devices/Type/sdkconfig.defaults
```kconfig
CONFIG_FREERTOS_HZ=1000
 
CONFIG_ESP_TASK_WDT_CHECK_IDLE_TASK_CPU0=n
CONFIG_ESP_TASK_WDT_CHECK_IDLE_TASK_CPU1=n

CONFIG_FREERTOS_TIMER_TASK_STACK_DEPTH=4096

CONFIG_EFUSE_CODE_SCHEME_COMPAT_NONE=y

CONFIG_BT_ENABLED=y
CONFIG_BT_BLUEDROID_ENABLED=y
CONFIG_BT_BLE_42_FEATURES_SUPPORTED=y

CONFIG_ULP_COPROC_ENABLED=y
CONFIG_ULP_COPROC_RISCV=y
CONFIG_ULP_COPROC_RESERVE_MEM=4096

CONFIG_RMT_SUPPRESS_DEPRECATE_WARN=y
```
